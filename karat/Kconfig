## karat/Kconfig
```kconfig
# nRF52840 DK NRF52840 board configuration

# Copyright (c) 2016 Nordic Semiconductor ASA
# SPDX-License-Identifier: Apache-2.0



config BOARD_ENABLE_DCDC
	bool "DCDC mode"
	select SOC_DCDC_NRF52X
	default y
	depends on BOARD_KARAT

config BOARD_ENABLE_DCDC_HV
	bool "High Voltage DCDC converter"
	select SOC_DCDC_NRF52X_HV
	default y
	depends on BOARD_KARAT

config BOARD_HAS_NRF5_BOOTLOADER
	bool "Board has nRF5 bootloader"
	default y
	depends on BOARD_KARAT
```

## karat/Kconfig.defconfig
```kconfig
# nRF52840 DK NRF52840 board configuration

# Copyright (c) 2016 Nordic Semiconductor ASA
# SPDX-License-Identifier: Apache-2.0

if BOARD_KARAT

config ZMK_KEYBOARD_NAME
    default "karat"

config FLASH_LOAD_OFFSET
	default 0x1000
	depends on BOARD_HAS_NRF5_BOOTLOADER && !USE_DT_CODE_PARTITION

if USB_DEVICE_STACK

#config USB_NRFX
#    default y

config SERIAL
	default y

endif # USB_DEVICE_STACK

config BT_CTLR
    default BT

endif
```

## karat/karat_defconfig
```kconfig
CONFIG_SOC_SERIES_NRF52X=y
CONFIG_SOC_NRF52840_QIAA=y
CONFIG_BOARD_KARAT=y

CONFIG_USB_DEVICE_STACK=y

CONFIG_SPI=y

# Enable MPU
CONFIG_ARM_MPU=y

CONFIG_PINCTRL=y

CONFIG_BOARD_ENABLE_DCDC_HV=y

CONFIG_HW_STACK_PROTECTION=y

CONFIG_USE_DT_CODE_PARTITION=y
CONFIG_BUILD_OUTPUT_UF2=y

# enable GPIO
CONFIG_GPIO=y

CONFIG_GPIO_AS_PINRESET=y
CONFIG_NFCT_PINS_AS_GPIOS=y

CONFIG_MPU_ALLOW_FLASH_WRITE=y
CONFIG_NVS=y
CONFIG_SETTINGS_NVS=y
CONFIG_FLASH=y
CONFIG_FLASH_PAGE_LAYOUT=y
CONFIG_FLASH_MAP=y

#CONFIG_ZMK_RGB_UNDERGLOW=y
#CONFIG_WS2812_STRIP=y


#CONFIG_ZMK_RGB_UNDERGLOW_ON_START=y
#CONFIG_ZMK_RGB_UNDERGLOW_HUE_START=160
#CONFIG_ZMK_RGB_UNDERGLOW_EFF_START=3


CONFIG_ZMK_USB=y
CONFIG_ZMK_BLE=y
```
